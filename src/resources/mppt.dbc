VERSION ""

NS_ :

BS_:

BU_: MPPT_0x600 MPPT_0x610 MPPT_0x620

BO_ 1536 Input_measurements: 8 MPPT_0x600
 SG_ Input_current : 32|32@1- (1,0) [-10000|10000] "Amps" Vector__XXX
 SG_ Input_voltage : 0|32@1- (1,0) [-10000|10000] "Volts" Vector__XXX

BO_ 1537 Output_measurments: 8 MPPT_0x600
 SG_ Output_current : 32|32@1- (1,0) [-10000|10000] "Amps" Vector__XXX
 SG_ Output_voltage : 0|32@1- (1,0) [-10000|10000] "Volts" Vector__XXX

BO_ 1538 Temperature: 8 MPPT_0x600
 SG_ Controller_temperature : 32|32@1- (1,0) [-10000|10000] "" Vector__XXX
 SG_ Mosfet_temperature : 0|32@1- (1,0) [-10000|10000] "Celsius" Vector__XXX

BO_ 1539 Auxiliary_power_supply: 8 MPPT_0x600
 SG_ Three_V : 32|32@1- (1,0) [-10000|10000] "Volts" Vector__XXX
 SG_ Twelve_V : 0|32@1- (1,0) [-10000|10000] "Volts" Vector__XXX

BO_ 1540 Limits: 8 MPPT_0x600
 SG_ Max_input_current : 32|32@1- (1,0) [-10000|10000] "Amps" Vector__XXX
 SG_ Max_output_voltage : 0|32@1- (1,0) [-10000|10000] "Volts" Vector__XXX

BO_ 1541 Status: 8 MPPT_0x600
 SG_ Test_counter : 56|8@1+ (1,0) [-10000|10000] "" Vector__XXX
 SG_ Mode : 40|8@1+ (1,0) [-10000|10000] "" Vector__XXX
 SG_ Input_current_min : 39|1@1+ (1,0) [-10000|10000] "" Vector__XXX
 SG_ Input_current_max : 38|1@1+ (1,0) [-10000|10000] "" Vector__XXX
 SG_ Output_voltage_max : 37|1@1+ (1,0) [-10000|10000] "" Vector__XXX
 SG_ Mosfet_temperature_error : 36|1@1+ (1,0) [-10000|10000] "" Vector__XXX
 SG_ Duty_cycle_min : 35|1@1+ (1,0) [-10000|10000] "" Vector__XXX
 SG_ Duty_cycle_max : 34|1@1+ (1,0) [-10000|10000] "" Vector__XXX
 SG_ Local_MPPT : 33|1@1+ (1,0) [-10000|10000] "" Vector__XXX
 SG_ Global_MPPT : 32|1@1+ (1,0) [-10000|10000] "" Vector__XXX
 SG_ Low_array_power : 31|1@1+ (1,0) [-10000|10000] "" Vector__XXX
 SG_ Mosfet_overheat : 30|1@1+ (1,0) [-10000|10000] "" Vector__XXX
 SG_ Battery_low : 29|1@1+ (1,0) [-10000|10000] "" Vector__XXX
 SG_ Batter_full : 28|1@1+ (1,0) [-10000|10000] "" Vector__XXX
 SG_ Twelve_V_undervoltage : 27|1@1+ (1,0) [-10000|10000] "" Vector__XXX
 SG_ HW_overcurrent : 25|1@1+ (1,0) [-10000|10000] "" Vector__XXX
 SG_ HW_overvoltage : 24|1@1+ (1,0) [-10000|10000] "" Vector__XXX
 SG_ CAN_TX_overflow_counter : 16|8@1+ (1,0) [-10000|10000] "" Vector__XXX
 SG_ CAN_TX_error_counter : 8|8@1+ (1,0) [-10000|10000] "" Vector__XXX
 SG_ CAN_RX_error_counter : 0|8@1+ (1,0) [-10000|10000] "" Vector__XXX

BO_ 1542 Power_connector: 8 MPPT_0x600
 SG_ Power_connector_temperature : 32|32@1- (1,0) [-10000|10000] "Celsius" Vector__XXX
 SG_ Power_connector_output_voltage : 0|32@1- (1,0) [-10000|10000] "Volts" Vector__XXX

BO_ 1543 Sweep_measurements: 8 MPPT_0x600
 SG_ Sweep_input_current : 32|32@1- (1,0) [-10000|10000] "Amps" Vector__XXX
 SG_ Sweep_input_voltage : 0|32@1- (1,0) [-10000|10000] "Volts" Vector__XXX

BO_ 1552 Input_measurements: 8 MPPT_0x610
 SG_ Input_current : 32|32@1- (1,0) [-10000|10000] "Amps" Vector__XXX
 SG_ Input_voltage : 0|32@1- (1,0) [-10000|10000] "Volts" Vector__XXX

BO_ 1553 Output_measurments: 8 MPPT_0x610
 SG_ Output_current : 32|32@1- (1,0) [-10000|10000] "Amps" Vector__XXX
 SG_ Output_voltage : 0|32@1- (1,0) [-10000|10000] "Volts" Vector__XXX

BO_ 1554 Temperature: 8 MPPT_0x610
 SG_ Controller_temperature : 32|32@1- (1,0) [-10000|10000] "" Vector__XXX
 SG_ Mosfet_temperature : 0|32@1- (1,0) [-10000|10000] "Celsius" Vector__XXX

BO_ 1555 Auxiliary_power_supply: 8 MPPT_0x610
 SG_ Three_V : 32|32@1- (1,0) [-10000|10000] "Volts" Vector__XXX
 SG_ Twelve_V : 0|32@1- (1,0) [-10000|10000] "Volts" Vector__XXX

BO_ 1556 Limits: 8 MPPT_0x610
 SG_ Max_input_current : 32|32@1- (1,0) [-10000|10000] "Amps" Vector__XXX
 SG_ Max_output_voltage : 0|32@1- (1,0) [-10000|10000] "Volts" Vector__XXX

BO_ 1557 Status: 8 MPPT_0x610
 SG_ Test_counter : 56|8@1+ (1,0) [-10000|10000] "" Vector__XXX
 SG_ Mode : 40|8@1+ (1,0) [-10000|10000] "" Vector__XXX
 SG_ Input_current_min : 39|1@1+ (1,0) [-10000|10000] "" Vector__XXX
 SG_ Input_current_max : 38|1@1+ (1,0) [-10000|10000] "" Vector__XXX
 SG_ Output_voltage_max : 37|1@1+ (1,0) [-10000|10000] "" Vector__XXX
 SG_ Mosfet_temperature_error : 36|1@1+ (1,0) [-10000|10000] "" Vector__XXX
 SG_ Duty_cycle_min : 35|1@1+ (1,0) [-10000|10000] "" Vector__XXX
 SG_ Duty_cycle_max : 34|1@1+ (1,0) [-10000|10000] "" Vector__XXX
 SG_ Local_MPPT : 33|1@1+ (1,0) [-10000|10000] "" Vector__XXX
 SG_ Global_MPPT : 32|1@1+ (1,0) [-10000|10000] "" Vector__XXX
 SG_ Low_array_power : 31|1@1+ (1,0) [-10000|10000] "" Vector__XXX
 SG_ Mosfet_overheat : 30|1@1+ (1,0) [-10000|10000] "" Vector__XXX
 SG_ Battery_low : 29|1@1+ (1,0) [-10000|10000] "" Vector__XXX
 SG_ Batter_full : 28|1@1+ (1,0) [-10000|10000] "" Vector__XXX
 SG_ Twelve_V_undervoltage : 27|1@1+ (1,0) [-10000|10000] "" Vector__XXX
 SG_ HW_overcurrent : 25|1@1+ (1,0) [-10000|10000] "" Vector__XXX
 SG_ HW_overvoltage : 24|1@1+ (1,0) [-10000|10000] "" Vector__XXX
 SG_ CAN_TX_overflow_counter : 16|8@1+ (1,0) [-10000|10000] "" Vector__XXX
 SG_ CAN_TX_error_counter : 8|8@1+ (1,0) [-10000|10000] "" Vector__XXX
 SG_ CAN_RX_error_counter : 0|8@1+ (1,0) [-10000|10000] "" Vector__XXX

BO_ 1558 Power_connector: 8 MPPT_0x610
 SG_ Power_connector_temperature : 32|32@1- (1,0) [-10000|10000] "Celsius" Vector__XXX
 SG_ Power_connector_output_voltage : 0|32@1- (1,0) [-10000|10000] "Volts" Vector__XXX

BO_ 1559 Sweep_measurements: 8 MPPT_0x610
 SG_ Sweep_input_current : 32|32@1- (1,0) [-10000|10000] "Amps" Vector__XXX
 SG_ Sweep_input_voltage : 0|32@1- (1,0) [-10000|10000] "Volts" Vector__XXX

BO_ 1568 Input_measurements: 8 MPPT_0x620
 SG_ Input_current : 32|32@1- (1,0) [-10000|10000] "Amps" Vector__XXX
 SG_ Input_voltage : 0|32@1- (1,0) [-10000|10000] "Volts" Vector__XXX

BO_ 1569 Output_measurments: 8 MPPT_0x620
 SG_ Output_current : 32|32@1- (1,0) [-10000|10000] "Amps" Vector__XXX
 SG_ Output_voltage : 0|32@1- (1,0) [-10000|10000] "Volts" Vector__XXX

BO_ 1570 Temperature: 8 MPPT_0x620
 SG_ Controller_temperature : 32|32@1- (1,0) [-10000|10000] "" Vector__XXX
 SG_ Mosfet_temperature : 0|32@1- (1,0) [-10000|10000] "Celsius" Vector__XXX

BO_ 1571 Auxiliary_power_supply: 8 MPPT_0x620
 SG_ Three_V : 32|32@1- (1,0) [-10000|10000] "Volts" Vector__XXX
 SG_ Twelve_V : 0|32@1- (1,0) [-10000|10000] "Volts" Vector__XXX

BO_ 1572 Limits: 8 MPPT_0x620
 SG_ Max_input_current : 32|32@1- (1,0) [-10000|10000] "Amps" Vector__XXX
 SG_ Max_output_voltage : 0|32@1- (1,0) [-10000|10000] "Volts" Vector__XXX

BO_ 1573 Status: 8 MPPT_0x620
 SG_ Test_counter : 56|8@1+ (1,0) [-10000|10000] "" Vector__XXX
 SG_ Mode : 40|8@1+ (1,0) [-10000|10000] "" Vector__XXX
 SG_ Input_current_min : 39|1@1+ (1,0) [-10000|10000] "" Vector__XXX
 SG_ Input_current_max : 38|1@1+ (1,0) [-10000|10000] "" Vector__XXX
 SG_ Output_voltage_max : 37|1@1+ (1,0) [-10000|10000] "" Vector__XXX
 SG_ Mosfet_temperature_error : 36|1@1+ (1,0) [-10000|10000] "" Vector__XXX
 SG_ Duty_cycle_min : 35|1@1+ (1,0) [-10000|10000] "" Vector__XXX
 SG_ Duty_cycle_max : 34|1@1+ (1,0) [-10000|10000] "" Vector__XXX
 SG_ Local_MPPT : 33|1@1+ (1,0) [-10000|10000] "" Vector__XXX
 SG_ Global_MPPT : 32|1@1+ (1,0) [-10000|10000] "" Vector__XXX
 SG_ Low_array_power : 31|1@1+ (1,0) [-10000|10000] "" Vector__XXX
 SG_ Mosfet_overheat : 30|1@1+ (1,0) [-10000|10000] "" Vector__XXX
 SG_ Battery_low : 29|1@1+ (1,0) [-10000|10000] "" Vector__XXX
 SG_ Batter_full : 28|1@1+ (1,0) [-10000|10000] "" Vector__XXX
 SG_ Twelve_V_undervoltage : 27|1@1+ (1,0) [-10000|10000] "" Vector__XXX
 SG_ HW_overcurrent : 25|1@1+ (1,0) [-10000|10000] "" Vector__XXX
 SG_ HW_overvoltage : 24|1@1+ (1,0) [-10000|10000] "" Vector__XXX
 SG_ CAN_TX_overflow_counter : 16|8@1+ (1,0) [-10000|10000] "" Vector__XXX
 SG_ CAN_TX_error_counter : 8|8@1+ (1,0) [-10000|10000] "" Vector__XXX
 SG_ CAN_RX_error_counter : 0|8@1+ (1,0) [-10000|10000] "" Vector__XXX

BO_ 1574 Power_connector: 8 MPPT_0x620
 SG_ Power_connector_temperature : 32|32@1- (1,0) [-10000|10000] "Celsius" Vector__XXX
 SG_ Power_connector_output_voltage : 0|32@1- (1,0) [-10000|10000] "Volts" Vector__XXX

BO_ 1575 Sweep_measurements: 8 MPPT_0x620
 SG_ Sweep_input_current : 32|32@1- (1,0) [-10000|10000] "Amps" Vector__XXX
 SG_ Sweep_input_voltage : 0|32@1- (1,0) [-10000|10000] "Volts" Vector__XXX

SIG_VALTYPE_ 1536 Input_voltage : 1;
SIG_VALTYPE_ 1536 Input_current : 1;
SIG_VALTYPE_ 1537 Output_voltage : 1;
SIG_VALTYPE_ 1537 Output_current : 1;
SIG_VALTYPE_ 1538 Mosfet_temperature : 1;
SIG_VALTYPE_ 1538 Controller_temperature : 1;
SIG_VALTYPE_ 1539 Twelve_V : 1;
SIG_VALTYPE_ 1539 Three_V : 1;
SIG_VALTYPE_ 1540 Max_output_voltage : 1;
SIG_VALTYPE_ 1540 Max_input_current : 1;
SIG_VALTYPE_ 1542 Power_connector_output_voltage : 1;
SIG_VALTYPE_ 1542 Power_connector_temperature : 1;
SIG_VALTYPE_ 1543 Sweep_input_voltage : 1;
SIG_VALTYPE_ 1543 Sweep_input_current : 1;
SIG_VALTYPE_ 1552 Input_voltage : 1;
SIG_VALTYPE_ 1552 Input_current : 1;
SIG_VALTYPE_ 1553 Output_voltage : 1;
SIG_VALTYPE_ 1553 Output_current : 1;
SIG_VALTYPE_ 1554 Mosfet_temperature : 1;
SIG_VALTYPE_ 1554 Controller_temperature : 1;
SIG_VALTYPE_ 1555 Twelve_V : 1;
SIG_VALTYPE_ 1555 Three_V : 1;
SIG_VALTYPE_ 1556 Max_output_voltage : 1;
SIG_VALTYPE_ 1556 Max_input_current : 1;
SIG_VALTYPE_ 1558 Power_connector_output_voltage : 1;
SIG_VALTYPE_ 1558 Power_connector_temperature : 1;
SIG_VALTYPE_ 1559 Sweep_input_voltage : 1;
SIG_VALTYPE_ 1559 Sweep_input_current : 1;
SIG_VALTYPE_ 1568 Input_voltage : 1;
SIG_VALTYPE_ 1568 Input_current : 1;
SIG_VALTYPE_ 1569 Output_voltage : 1;
SIG_VALTYPE_ 1569 Output_current : 1;
SIG_VALTYPE_ 1570 Mosfet_temperature : 1;
SIG_VALTYPE_ 1570 Controller_temperature : 1;
SIG_VALTYPE_ 1571 Twelve_V : 1;
SIG_VALTYPE_ 1571 Three_V : 1;
SIG_VALTYPE_ 1572 Max_output_voltage : 1;
SIG_VALTYPE_ 1572 Max_input_current : 1;
SIG_VALTYPE_ 1574 Power_connector_output_voltage : 1;
SIG_VALTYPE_ 1574 Power_connector_temperature : 1;
SIG_VALTYPE_ 1575 Sweep_input_voltage : 1;
SIG_VALTYPE_ 1575 Sweep_input_current : 1;
